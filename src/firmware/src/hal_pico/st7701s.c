#include "st7701s.h"
#include "pico/stdlib.h"

#define PIN_RST 11
#define PIN_CS 13
#define PIN_SCK 14
#define PIN_SDA 15

#define CMD_DELAY 0xFE // table sentinel: next byte = delay in ms

// ER-TFT028A5-4 init (BuyDisplay), RGB565 (0x3A=0x55). rows: cmd, nparams, ...
static const uint8_t INIT[] = {
    0xFF, 5, 0x77, 0x01, 0x00, 0x00, 0x13,
    0xEF, 1, 0x08,
    0xFF, 5, 0x77, 0x01, 0x00, 0x00, 0x10,
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    0x11, 0,       // sleep out
    CMD_DELAY, 1, 120,
    0x36, 1, 0x00,
    0x35, 1, 0x00,
    0x29, 0, // display on
};

static void spi_send(uint8_t b) {
  for (int n = 0; n < 8; n++) {
    gpio_put(PIN_SCK, 0);
    gpio_put(PIN_SDA, (b & 0x80) ? 1 : 0);
    b <<= 1;
    sleep_us(1);
    gpio_put(PIN_SCK, 1);
    sleep_us(1);
  }
}

// 9-bit word: leading bit dc (0=command, 1=data), then the byte
static void spi_word(bool dc, uint8_t v) {
  gpio_put(PIN_CS, 0);
  gpio_put(PIN_SCK, 0);
  gpio_put(PIN_SDA, dc);
  sleep_us(1);
  gpio_put(PIN_SCK, 1);
  sleep_us(1);
  spi_send(v);
  gpio_put(PIN_CS, 1);
}

void st7701s_init(void) {
  gpio_init(PIN_RST);
  gpio_init(PIN_CS);
  gpio_init(PIN_SCK);
  gpio_init(PIN_SDA);
  gpio_set_dir(PIN_RST, GPIO_OUT);
  gpio_set_dir(PIN_CS, GPIO_OUT);
  gpio_set_dir(PIN_SCK, GPIO_OUT);
  gpio_set_dir(PIN_SDA, GPIO_OUT);
  gpio_put(PIN_CS, 1);

  gpio_put(PIN_RST, 1);
  sleep_ms(10);
  gpio_put(PIN_RST, 0);
  sleep_ms(10);
  gpio_put(PIN_RST, 1);
  sleep_ms(120);

  for (size_t i = 0; i < sizeof(INIT);) {
    uint8_t cmd = INIT[i++];
    uint8_t n = INIT[i++];
    if (cmd == CMD_DELAY) {
      sleep_ms(INIT[i]);
      i += n;
      continue;
    }
    spi_word(false, cmd);
    for (uint8_t k = 0; k < n; k++)
      spi_word(true, INIT[i++]);
  }
}
